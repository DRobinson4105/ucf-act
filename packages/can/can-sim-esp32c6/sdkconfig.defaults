## packages/can/control-esp32/sdkconfig.defaults
```kconfig
# Flash configuration
CONFIG_ESPTOOLPY_FLASHSIZE_8MB=y
CONFIG_SPI_FLASH_SUPPORT_GD_CHIP=y

# Task watchdog and stack overflow detection
CONFIG_ESP_TASK_WDT_EN=y
CONFIG_ESP_TASK_WDT_TIMEOUT_S=10
CONFIG_ESP_TASK_WDT_PANIC=y
CONFIG_FREERTOS_CHECK_STACKOVERFLOW_CANARY=y

# Panic handler: print panic and reboot to return to a known-safe state
CONFIG_ESP_SYSTEM_PANIC_PRINT_REBOOT=y

# Production build guard — uncomment for vehicle deployment builds
# CONFIG_PRODUCTION_BUILD=y

# Explicit bypass defaults — all disabled.
# These are the Kconfig defaults but are set explicitly here to prevent
# accidental leakage from a dirty sdkconfig.
# CONFIG_BYPASS_SAFETY_TARGET_MIRROR is not set
# CONFIG_BYPASS_SAFETY_ESTOP_MIRROR is not set
# CONFIG_BYPASS_SAFETY_LIVENESS_CHECKS is not set
# CONFIG_BYPASS_PLANNER_COMMAND_INPUTS is not set
# CONFIG_BYPASS_PLANNER_COMMAND_STALE_CHECKS is not set
# CONFIG_BYPASS_INPUT_PEDAL_ADC is not set
# CONFIG_BYPASS_INPUT_FR_SENSOR is not set
# CONFIG_BYPASS_ACTUATOR_MULTIPLEXER is not set
# CONFIG_BYPASS_ACTUATOR_PEDAL_RELAY is not set
# CONFIG_BYPASS_ACTUATOR_STEPPER_STEERING is not set
# CONFIG_BYPASS_ACTUATOR_STEPPER_BRAKING is not set
```

## packages/can/furrycon2026/components/twai_port/Kconfig
```kconfig
menu "TWAI Port Configuration"

    config APP_TWAI_TX_GPIO
        int "TX GPIO number"
        default 5
        range 0 48
        help
            GPIO pin connected to the CAN transceiver TX line.

    config APP_TWAI_RX_GPIO
        int "RX GPIO number"
        default 5
        range 0 48
        help
            GPIO pin connected to the CAN transceiver RX line.

    choice APP_TWAI_BITRATE_CHOICE
        prompt "Bitrate"
        default APP_TWAI_BITRATE_1M
        help
            CAN bus bitrate.

        config APP_TWAI_BITRATE_125K
            bool "125 kbit/s"
        config APP_TWAI_BITRATE_250K
            bool "250 kbit/s"
        config APP_TWAI_BITRATE_500K
            bool "500 kbit/s"
        config APP_TWAI_BITRATE_800K
            bool "800 kbit/s"
        config APP_TWAI_BITRATE_1M
            bool "1 Mbit/s"
    endchoice

    config APP_TWAI_BITRATE
        int
        default 125000 if APP_TWAI_BITRATE_125K
        default 250000 if APP_TWAI_BITRATE_250K
        default 500000 if APP_TWAI_BITRATE_500K
        default 800000 if APP_TWAI_BITRATE_800K
        default 1000000 if APP_TWAI_BITRATE_1M

    config APP_TWAI_TX_QUEUE_LEN
        int "TX queue length"
        default 8
        range 1 100

    config APP_TWAI_RX_QUEUE_LEN
        int "RX queue length"
        default 8
        range 1 100

    config APP_TWAI_DEFAULT_TIMEOUT_MS
        int "Default send/receive timeout (ms)"
        default 100
        range 1 10000

    choice APP_TWAI_MODE
        prompt "TWAI operating mode"
        default APP_TWAI_MODE_NORMAL
        help
            Select the TWAI controller operating mode.

        config APP_TWAI_MODE_NORMAL
            bool "Normal"
            help
                Standard CAN operation. Requires at least one other node on
                the bus to acknowledge transmitted frames.

        config APP_TWAI_MODE_LISTEN_ONLY
            bool "Listen-only"
            help
                The controller receives frames but does not transmit. Useful
                for bus monitoring.

        config APP_TWAI_MODE_NO_ACK
            bool "No-ACK (test only — do not use in production)"
            help
                The controller transmits without waiting for an acknowledgement
                bit. Use only when testing with a single node and no other CAN
                device on the bus. Not suitable for production.

    endchoice

    menu "Logging"

        config APP_TWAI_LOG_TX
            bool "Log TX frames"
            default y

        config APP_TWAI_LOG_RX
            bool "Log RX frames"
            default y

        config APP_TWAI_LOG_ALERTS
            bool "Log alerts and state transitions"
            default y

        config APP_TWAI_LOG_EXT_ONLY
            bool "Limit frame logging to extended IDs only"
            default n

    endmenu

endmenu
```

## packages/can/furrycon2026/sdkconfig.defaults
```kconfig
# Project-wide TWAI defaults.
# Edit this file (or run `idf.py menuconfig`) to change settings.
# Do not hand-edit sdkconfig — it is generated.

CONFIG_APP_TWAI_TX_GPIO=4
CONFIG_APP_TWAI_RX_GPIO=5
CONFIG_APP_TWAI_BITRATE_1M=y
CONFIG_APP_TWAI_MODE_NO_ACK=y
CONFIG_APP_TWAI_TX_QUEUE_LEN=8
CONFIG_APP_TWAI_RX_QUEUE_LEN=8
CONFIG_APP_TWAI_DEFAULT_TIMEOUT_MS=100
CONFIG_APP_TWAI_LOG_TX=y
CONFIG_APP_TWAI_LOG_RX=y
CONFIG_APP_TWAI_LOG_ALERTS=y
```

## packages/can/motor-config-util/main/Kconfig.projbuild
```kconfig
menu "SC3 Sender"

    config CAN_TX_GPIO
        int "TWAI TX GPIO number"
        range 0 48
        default 4
        help
            GPIO pin connected to the CAN transceiver TX line.

    config CAN_RX_GPIO
        int "TWAI RX GPIO number"
        range 0 48
        default 5
        help
            GPIO pin connected to the CAN transceiver RX line.

    config MOTOR_TARGET
        int "Motor target (1 = braking, 2 = steering)"
        range 1 2
        default 1
        help
            1 = braking motor, 2 = steering motor.

    config FACTORY_RESET
        bool "Factory reset motor after configuration"
        default n
        help
            When enabled, two additional cw=0x7E frames are sent after the
            normal save frame: one with data byte 0 = 2 (factory reset
            command) followed by one with data byte 0 = 1 (save), matching
            the motor's factory-reset sequence.

endmenu
```

## packages/can/motor-config-util/sdkconfig.defaults
```kconfig
CONFIG_IDF_TARGET="esp32c6"
CONFIG_CAN_TX_GPIO=4
CONFIG_CAN_RX_GPIO=5
CONFIG_MOTOR_TARGET=1
```

## packages/can/safety-esp32/main/Kconfig
```kconfig
menu "Test Bypasses"

    config BYPASS_PLANNER_HEARTBEAT
        bool "Bypass Planner heartbeat check"
        default n
        help
            Treat the Planner (Jetson) as always alive. Prevents
            NODE_FAULT_ESTOP_PLANNER_TIMEOUT when testing Safety
            without a Planner on the CAN bus.

    config BYPASS_CONTROL_HEARTBEAT
        bool "Bypass Control heartbeat check"
        default n
        help
            Treat the Control ESP32 as always alive. Prevents
            NODE_FAULT_ESTOP_CONTROL_TIMEOUT when testing Safety
            without a Control ESP32 on the CAN bus.

    config BYPASS_PUSH_BUTTON
        bool "Bypass push button e-stop (HB2-ES544)"
        default n
        help
            Force the push button e-stop to always read as inactive
            (not pressed). Use when the HB2-ES544 is not connected
            during bench testing.

    config BYPASS_RF_REMOTE
        bool "Bypass RF remote e-stop (EV1527)"
        default n
        help
            Force the RF remote e-stop to always read as inactive
            (not engaged). Use when the EV1527 RF remote receiver
            is not connected during bench testing.

    config BYPASS_ULTRASONIC
        bool "Bypass ultrasonic sensor (A02YYUW)"
        default n
        help
            Force the ultrasonic sensor to always read as clear
            (no obstacle) and healthy. Use when the A02YYUW sensor
            is not connected during bench testing. Without this
            bypass, a disconnected sensor triggers estop_ultrasonic
            due to the fail-safe health check.

endmenu

menu "Debug Logging"

    config LOG_HEARTBEAT_TX
        bool "Log periodic heartbeat TX"
        default n
        help
            Log every periodic heartbeat transmission (100ms interval).
            Very verbose. Useful for confirming CAN TX is working.
            State-change heartbeats are always logged regardless.

    config LOG_HEARTBEAT_RX
        bool "Log every heartbeat RX"
        default n
        help
            Log every received Planner and Control heartbeat, not just
            state changes. Very verbose. Useful for confirming CAN RX
            is working and checking sequence numbers.

    config LOG_ESTOP_INPUTS
        bool "Log e-stop input readings each cycle"
        default n
        help
            Log all e-stop input readings (button, remote, ultrasonic,
            planner, control) every safety loop iteration (50ms).
            Extremely verbose. Useful for debugging sensor wiring.

    config LOG_STATE_MACHINE
        bool "Log state machine evaluation each cycle"
        default n
        help
            Log the system state machine inputs and result every
            safety loop iteration. Verbose. Useful for debugging
            state advancement issues.

    menu "Push Button (HB2-ES544)"

        config LOG_PUSH_BUTTON
            bool "Log push button state changes"
            default n
            help
                Log when the push button e-stop changes state
                (pressed/released). Useful for verifying wiring
                and switch operation.

    endmenu

    menu "RF Remote (EV1527)"

        config LOG_RF_REMOTE
            bool "Log RF remote state changes"
            default n
            help
                Log when the RF remote e-stop changes state
                (engaged/disengaged). Useful for verifying
                receiver wiring and remote operation.

    endmenu

    menu "Power Relay (SRD-05VDC)"

        config LOG_RELAY_STATE
            bool "Log power relay state changes"
            default y
            help
                Log when the power relay is enabled or disabled.
                Enabled by default since relay transitions are
                infrequent and safety-relevant.

    endmenu

    menu "Ultrasonic Sensor (A02YYUW)"

        config LOG_ULTRASONIC_DISTANCE
            bool "Log parsed distance readings"
            default n
            help
                Log every valid distance reading from the A02YYUW sensor.
                Verbose (~5-10 logs/sec). Useful for verifying sensor
                operation and checking distance values.

        config LOG_ULTRASONIC_RX
            bool "Log raw UART RX bytes"
            default n
            help
                Log raw hex bytes received from the A02YYUW UART.
                Extremely verbose (~10 logs/sec). Useful for debugging
                wiring or protocol issues at the byte level.

        config LOG_ULTRASONIC_PARSE_ERRORS
            bool "Log parse failures"
            default n
            help
                Log when received UART bytes fail to parse as valid
                A02YYUW frames (bad checksum, missing header). Useful
                for diagnosing noisy or intermittent connections.

    endmenu

endmenu
```
