## packages/can/control-esp32/main/Kconfig.projbuild
```kconfig
config PRODUCTION_BUILD
    bool "Production build (disallow test bypasses)"
    default n
    help
        Enable this for production/vehicle deployment builds.
        If any BYPASS_* option is enabled alongside this flag,
        the firmware will fail to compile with a clear error.
        This prevents accidental deployment of bench-test firmware
        onto the vehicle.

config CONTROL_TEST_MODE
    bool "Control test mode (standalone serial actuator control)"
    default n
    help
        Replace the normal Orin+CAN control loop with a standalone
        bench test task for a single selected actuator. The selected
        actuator is driven from USB serial input while periodic status
        is logged on the console.

        Useful for validating throttle, steering, or braking hardware
        on the cart without the full Safety/Orin stack running.

if CONTROL_TEST_MODE

choice CONTROL_TEST_ACTUATOR
    prompt "Control test actuator"
    default CONTROL_TEST_ACTUATOR_THROTTLE
    help
        Select which actuator the standalone control test task owns.
        Only one actuator is driven in a test build.

    config CONTROL_TEST_ACTUATOR_THROTTLE
        bool "Throttle"
        help
            Standalone DAC/relay/pedal/F/R throttle test.

    config CONTROL_TEST_ACTUATOR_STEERING
        bool "Steering"
        help
            Standalone steering motor PT target test over CAN.

    config CONTROL_TEST_ACTUATOR_BRAKING
        bool "Braking"
        help
            Standalone braking motor PT target test over CAN.

endchoice

endif

menu "Motor Limits"

    menu "Steering Motor"

        config STEERING_LM0_MAX_SPEED
            int "LM[0]: max working speed (pulses/sec)"
            range 0 2147483647
            default 160000
            help
                Maximum working speed sent to the steering motor (LM[0]).
                Only programmed when steering software limits are enabled.
                Units: pulses/sec.

        config STEERING_LM1_LOWER_LIMIT
            int "LM[1]: lower working limit (pulses)"
            range -2147483648 2147483647
            default -160000
            help
                Lower working position limit for the steering motor (LM[1]).
                Only programmed when steering software limits are enabled.
                Units: pulses (signed).

        config STEERING_LM2_UPPER_LIMIT
            int "LM[2]: upper working limit (pulses)"
            range -2147483648 2147483647
            default 160000
            help
                Upper working position limit for the steering motor (LM[2]).
                Only programmed when steering software limits are enabled.
                Units: pulses (signed).

        config STEERING_LM7_MAX_ACCEL
            int "LM[7]: max acceleration (pulses/sec^2)"
            range 0 2147483647
            default 5000
            help
                Maximum acceleration limit for the steering motor (LM[7]).
                Only programmed when steering software limits are enabled.
                Units: pulses/sec^2.

        config STEERING_AC_DEFAULT_ACCEL
            int "AC: default acceleration (pulses/sec^2)"
            range 1 2147483647
            default 5000
            help
                Acceleration rate sent to the steering motor via the AC
                register during initialization. Used by the motor for all
                non-PT motion and as a safety limit during PT interpolation.
                Units: pulses/sec^2.

        config STEERING_DC_DEFAULT_DECEL
            int "DC: default deceleration (pulses/sec^2)"
            range 1 2147483647
            default 5000
            help
                Deceleration rate sent to the steering motor via the DC
                register during initialization.
                Units: pulses/sec^2.

        config STEERING_SD_STOP_DECEL
            int "SD: emergency stop deceleration (pulses/sec^2)"
            range 1 2147483647
            default 8000
            help
                Emergency stop deceleration rate sent to the steering motor
                via the SD register during initialization. Also used (×10,
                overflow-guarded) when motor_uim2852_shutdown()
                is called at runtime.
                Units: pulses/sec^2.

    endmenu

    menu "Braking Motor"

        config BRAKING_LM0_MAX_SPEED
            int "LM[0]: max working speed (pulses/sec)"
            range 0 2147483647
            default 28000
            help
                Maximum working speed sent to the braking motor (LM[0]).
                Only programmed when braking software limits are enabled.
                Units: pulses/sec.

        config BRAKING_LM1_LOWER_LIMIT
            int "LM[1]: lower working limit (pulses)"
            range -2147483648 2147483647
            default -28000
            help
                Lower working position limit for the braking motor (LM[1]).
                Only programmed when braking software limits are enabled.
                Units: pulses (signed).

        config BRAKING_LM2_UPPER_LIMIT
            int "LM[2]: upper working limit (pulses)"
            range -2147483648 2147483647
            default 0
            help
                Upper working position limit for the braking motor (LM[2]).
                Only programmed when braking software limits are enabled.
                Units: pulses (signed).

        config BRAKING_LM7_MAX_ACCEL
            int "LM[7]: max acceleration (pulses/sec^2)"
            range 0 2147483647
            default 5000
            help
                Maximum acceleration limit for the braking motor (LM[7]).
                Only programmed when braking software limits are enabled.
                Units: pulses/sec^2.

        config BRAKE_RELEASE_POSITION
            int "Brake release position (pulses)"
            range -2147483648 2147483647
            default -28000
            help
                Runtime braking release position used by planner command
                translation and control-side clamping. This is distinct
                from LM[1], which remains the braking motor's configured
                lower software limit during limit initialization.
                Units: pulses (signed).

        config BRAKING_AC_DEFAULT_ACCEL
            int "AC: default acceleration (pulses/sec^2)"
            range 1 2147483647
            default 5000
            help
                Acceleration rate sent to the braking motor via the AC
                register during initialization. Used by the motor for all
                non-PT motion and as a safety limit during PT interpolation.
                Units: pulses/sec^2.

        config BRAKING_DC_DEFAULT_DECEL
            int "DC: default deceleration (pulses/sec^2)"
            range 1 2147483647
            default 5000
            help
                Deceleration rate sent to the braking motor via the DC
                register during initialization.
                Units: pulses/sec^2.

        config BRAKING_SD_STOP_DECEL
            int "SD: emergency stop deceleration (pulses/sec^2)"
            range 1 2147483647
            default 8000
            help
                Emergency stop deceleration rate sent to the braking motor
                via the SD register during initialization. Also used (×10,
                overflow-guarded) when motor_uim2852_shutdown()
                is called at runtime.
                Units: pulses/sec^2.

    endmenu

    menu "PT FIFO"

        config MOTOR_UIM2852_PT_FRAME_TIME_MS
            int "MP[4]: PT frame time (ms)"
            range 5 30000
            default 100
            help
                Fixed segment duration for every PT interpolation row,
                sent via MP[4] during PT FIFO configuration. Must match
                the planner's command cadence (default 100 ms).
                Units: milliseconds.

        config MOTOR_UIM2852_PT_LOW_WATER_MARK
            int "MP[5]: PT FIFO low-water mark (rows)"
            range 1 255
            default 1
            help
                FIFO low-water threshold sent via MP[5] during PT FIFO
                configuration. When the number of queued PT rows drops
                to this value the motor sends a FIFO-low warning
                notification, allowing the host to refill in time.
                Units: rows.

        config BRAKING_PT_STEP_LIMIT_PULSES_PER_500MS
            int "Braking PT target delta limit per 500 ms (pulses)"
            range 0 200000
            default 8000
            help
                Clamp each queued braking PT target update to this many
                pulses per 500 ms of commanded motion. The firmware scales
                that limit to the configured PT frame interval so braking
                stays bounded while following the configured planner/PT cadence.
                Set to 0 to disable the PT delta clamp.

    endmenu

endmenu

menu "Test Bypasses"

    menu "Safety Mirror"

        config BYPASS_SAFETY_TARGET_MIRROR
            bool "Bypass Safety target mirror: force ACTIVE"
            default n
            help
                Ignore Safety target state and force target_state=ACTIVE.
                Use when testing Control state progression without a
                Safety ESP32 heartbeat.

        config BYPASS_SAFETY_ESTOP_MIRROR
            bool "Bypass Safety stop/fault mirror: force clear"
            default n
            help
                Ignore Safety stop/fault channels and force
                safety_fault_flags=NONE, safety_stop_flags=NONE
                in Control task inputs and logs.

        config BYPASS_SAFETY_LIVENESS_CHECKS
            bool "Bypass Safety liveness check: ignore timeout"
            default n
            help
                Ignore Safety heartbeat timeout. Use when testing Control
                without a Safety ESP32 on the bus.

    endmenu

    menu "Planner Inputs"

        config BYPASS_PLANNER_COMMAND_INPUTS
            bool "Bypass Planner command inputs: force zero"
            default n
            help
                Force Planner command inputs to zero throttle/steering/braking.
                This does not disable timeout or stale-sequence checks.

        config BYPASS_PLANNER_COMMAND_STALE_CHECKS
            bool "Bypass Planner stale checks: disable timeout/stale"
            default n
            help
                Disable Planner command timeout and stale-sequence checks.
                Useful when Planner command cadence is irregular in bench tests.

    endmenu

    menu "Inputs"

        config BYPASS_INPUT_PEDAL_ADC
            bool "Bypass pedal ADC input: force released"
            default n
            help
                Skip accelerator pedal ADC readings. Pedal is forced to
                not pressed and always re-armed.

        config BYPASS_INPUT_FR_SENSOR
            bool "Bypass F/R sensor input: force FORWARD"
            default n
            help
                Force F/R selector reading to FORWARD regardless of hardware state.
                Use when F/R optocoupler channels are not connected.

    endmenu

    menu "Actuators"

        config BYPASS_ACTUATOR_THROTTLE
            bool "Bypass throttle actuator (DAC + DPDT relay)"
            default n
            help
                Skip MCP4728 DAC and MY5NJ DPDT relay control.


        config BYPASS_ACTUATOR_MOTOR_UIM2852_STEERING
            bool "Bypass steering motor actuator"
            default n
            help
                Skip steering motor (node 7) initialization,
                configuration, and CAN commands.

        config BYPASS_ACTUATOR_MOTOR_UIM2852_BRAKING
            bool "Bypass braking motor actuator"
            default n
            help
                Skip braking motor (node 6) initialization,
                configuration, and CAN commands.

    endmenu

endmenu

menu "Debug Logging"

    menu "Transport"

        rsource "../../common/kconfig/transport.kconfig"

        config LOG_TRANSPORT_ORIN_PLANNER_COMMAND_RX
            bool "Log Orin Planner command RX: every frame"
            default n
            help
                Log every received Planner command from the Orin UART link
                with sequence, throttle, steering, and braking values.
                Very verbose (up to 10 Hz).

    endmenu

    menu "Health & Recovery"

        rsource "../../common/kconfig/health.kconfig"

    endmenu

    menu "Control Logic"

        config LOG_CONTROL_STATE_CHANGES
            bool "Log control state changes"
            default y
            help
                Log each control state transition (e.g. READY -> ENABLE)
                with the reason for the transition.

        config LOG_CONTROL_FAULT_CHANGES
            bool "Log control fault code changes"
            default n
            help
                Log each control fault code transition with detail string.

        config LOG_CONTROL_PRECONDITION_BLOCKED
            bool "Log enable precondition failures"
            default y
            help
                Log when Control is not autonomy-ready because one or more
                preconditions failed (FR not
                forward, pedal pressed, pedal not re-armed, active fault).
                Edge-triggered: logs on first blocked tick and when the set
                of failed preconditions changes.

        config LOG_CONTROL_ENABLE_SEQUENCE
            bool "Log control enable sequence events"
            default n
            help
                Log enable sequence lifecycle: start, complete, abort (with
                reason), and motor enable failures.

        config LOG_CONTROL_OVERRIDE_CHANGES
            bool "Log control override events"
            default n
            help
                Log when a driver override is triggered with the reason
                (reverse, throttle, steering, braking).

        config LOG_CONTROL_SAFETY_TARGET_CHANGES
            bool "Log received Safety target/fault changes"
            default y
            help
                Log edge-triggered changes in the Safety target state and
                stop/fault flags as received by Control. These reflect what
                Safety is broadcasting, not Control's own state.

        config LOG_CONTROL_THROTTLE_CHANGES
            bool "Log control throttle changes"
            default n
            help
                Log each throttle level transition (edge-triggered).

    endmenu

    menu "Inputs"

        config LOG_INPUT_PEDAL_ADC_ERRORS
            bool "Log pedal ADC read errors"
            default n
            help
                Log pedal ADC read failures (I/O errors, out-of-range raw
                values). Does not log successful readings.

        config LOG_INPUT_PEDAL_CHANGES
            bool "Log pedal threshold/rearm events"
            default n
            help
                Log edge-triggered pedal input events: threshold crossed
                and pedal re-armed after release dwell.

        config LOG_INPUT_FR_DEBOUNCE
            bool "Log F/R debounce transitions"
            default n
            help
                Log raw F/R optocoupler pin state changes during debounce.

        config LOG_INPUT_FR_STATE_CHANGES
            bool "Log F/R state changes"
            default n
            help
                Log debounced F/R state transitions (FORWARD/REVERSE/NEUTRAL/INVALID).

    endmenu

    menu "Actuators"

        config LOG_ACTUATOR_DAC_WRITE
            bool "Log MCP4728 DAC register writes"
            default n
            help
                Log every MCP4728 I2C register write with the commanded
                DAC level. Useful for I2C bus debugging.

        config LOG_ACTUATOR_DPDT_RELAY_CHANGES
            bool "Log DPDT relay state changes"
            default n
            help
                Log MY5NJ DPDT relay energize/de-energize transitions.

        config LOG_ACTUATOR_MOTOR_UIM2852_INIT
            bool "Log motor init/configure handshake"
            default n
            help
                Log PT FIFO setup (MP register writes), initial status
                queries, and configure handshake results.

        config LOG_ACTUATOR_MOTOR_UIM2852_ENABLE_CHANGES
            bool "Log motor enable/disable (MO)"
            default n
            help
                Log MO enable/disable transitions for both motors.

        config LOG_ACTUATOR_MOTOR_UIM2852_COMMAND_TX
            bool "Log motor position commands sent over CAN"
            default n
            help
                Log PT FIFO feed commands for steering and braking motors.
                Includes position values and feed results.

        config LOG_ACTUATOR_MOTOR_UIM2852_MOTION_TX
            bool "Log motor motion commands (PA/PR/ST)"
            default n
            help
                Log motor motion commands (position absolute, position
                relative, stop) sent during enable sequence and runtime.

        config LOG_ACTUATOR_MOTOR_UIM2852_RX
            bool "Log parsed motor CAN RX frames"
            default n
            help
                Log parsed motor CAN responses: motion status,
                parameter reads, and command ACKs.

    endmenu

endmenu
```
