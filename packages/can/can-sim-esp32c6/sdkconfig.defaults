## packages/can/safety-esp32/main/Kconfig.projbuild
```kconfig
config PRODUCTION_BUILD
    bool "Production build (disallow test bypasses)"
    default n
    help
        Enable this for production/vehicle deployment builds.
        If any BYPASS_* option is enabled alongside this flag,
        the firmware will fail to compile with a clear error.
        This prevents accidental deployment of bench-test firmware
        onto the vehicle.

menu "Test Bypasses"

    menu "Planner/Control Mirrors"

        config BYPASS_PLANNER_AUTONOMY_GATE
            bool "Bypass Planner autonomy gate: force request=true"
            default n
            help
                Force Planner autonomy request true so Safety can advance
                READY -> ENABLE without an Orin request.

        config BYPASS_PLANNER_LIVENESS_CHECKS
            bool "Bypass Planner liveness checks"
            default n
            help
                Ignore Planner heartbeat timeout and Planner FAULT state
                from the Orin UART link.

        config BYPASS_PLANNER_STATE_MIRROR
            bool "Bypass Planner state mirror"
            default n
            help
                Simulate cooperative Planner behavior by mirroring Safety target
                state and forcing Planner enable_complete.

        config BYPASS_CONTROL_LIVENESS_CHECKS
            bool "Bypass Control liveness checks"
            default n
            help
                Ignore Control heartbeat timeout and Control FAULT state.

        config BYPASS_CONTROL_STATE_MIRROR
            bool "Bypass Control state mirror"
            default n
            help
                Simulate cooperative Control behavior by mirroring Safety target
                state and forcing Control enable_complete.

    endmenu

    menu "CAN"

        config BYPASS_CAN_TWAI
            bool "Bypass CAN/TWAI entirely"
            default n
            help
                Disable TWAI usage in Safety firmware for bench bring-up.
                Skips TWAI init/recovery and suppresses Safety/Control CAN
                heartbeat TX/RX. Does not disable the Orin UART link.
                Use when no transceiver/bus peers are connected.

    endmenu

    menu "Inputs"

        config BYPASS_INPUT_PUSH_BUTTON
            bool "Bypass push button input: force inactive"
            default n
            help
                Force push button reading to inactive (not pressed).

        config BYPASS_INPUT_RF_REMOTE
            bool "Bypass RF remote input: force inactive"
            default n
            help
                Force RF remote reading to inactive (not engaged).

        config BYPASS_INPUT_ULTRASONIC
            bool "Bypass ultrasonic input: force clear and healthy"
            default n
            help
                Force ultrasonic sensor to report no obstacle and healthy status.

        config BYPASS_INPUT_BATTERY_MONITOR
            bool "Bypass battery monitor: force 50% SOC"
            default n
            help
                Skip battery ADC initialization and force SOC to 50%.
                Use when no voltage divider or current sensor is connected.

    endmenu

endmenu

menu "Debug Logging"

    menu "Transport"

        rsource "../../common/kconfig/transport.kconfig"

        config LOG_TRANSPORT_ORIN_PLANNER_HEARTBEAT_RX
            bool "Log Orin Planner heartbeat RX: every frame"
            default n
            help
                Log every received Planner heartbeat from the Orin UART link
                with sequence, state, fault flags, and status flags.
                Very verbose (up to 10 Hz).

    endmenu

    menu "Health & Recovery"

        rsource "../../common/kconfig/health.kconfig"

    endmenu

    menu "Safety Logic"

        config LOG_SAFETY_STATE_CHANGES
            bool "Log Safety target state changes"
            default y
            help
                Log each system target state transition (e.g. READY -> ENABLE)
                with the reason (autonomy_request, enable_complete, autonomy_halt,
                or fault code). Also logs autonomy request lifecycle events
                (latched, consumed, re-armed).

        config LOG_SAFETY_FAULT_CHANGES
            bool "Log Safety fault flag changes"
            default y
            help
                Log each fault flag transition (e.g. none -> ultrasonic,
                ultrasonic -> none). Edge-triggered on fault flags change.

    endmenu

    menu "Inputs"

        config LOG_INPUT_PUSH_BUTTON_CHANGES
            bool "Log push-button input state changes"
            default n
            help
                Log push button pressed/released transitions (edge-triggered).

        config LOG_INPUT_RF_REMOTE_CHANGES
            bool "Log RF remote input state changes"
            default n
            help
                Log RF remote engaged/disengaged transitions (edge-triggered).

        config LOG_INPUT_ULTRASONIC_DISTANCE_TICK
            bool "Log ultrasonic parsed distance"
            default n
            help
                Log each valid ultrasonic distance reading in millimeters.

        config LOG_INPUT_ULTRASONIC_RX
            bool "Log ultrasonic raw UART RX"
            default n
            help
                Log raw bytes received on the ultrasonic UART. Very verbose.

        config LOG_INPUT_ULTRASONIC_PARSE_ERRORS
            bool "Log ultrasonic parse errors"
            default n
            help
                Log ultrasonic frame parse failures (checksum, length, etc.).

        config LOG_INPUT_BATTERY_TICK
            bool "Log battery voltage/current readings (verbose)"
            default n
            help
                Log battery pack voltage, current, and SOC on every update.
                Very verbose (20 Hz). Use for calibration and debugging.

        config LOG_INPUT_BATTERY_SOC_CHANGES
            bool "Log battery SOC percentage changes"
            default y
            help
                Log when SOC percentage changes by 1% or more (edge-triggered).
                Also logs voltage-based SOC recalibration events.

    endmenu

    menu "Actuators"

        config LOG_ACTUATOR_POWER_RELAY_CHANGES
            bool "Log power relay state changes"
            default n
            help
                Log power relay enabled/disabled transitions (edge-triggered).

    endmenu

endmenu
```

## packages/can/safety-esp32/sdkconfig.defaults
```kconfig
# Flash configuration
CONFIG_ESPTOOLPY_FLASHSIZE_4MB=y
CONFIG_SPI_FLASH_SUPPORT_GD_CHIP=y

# Task watchdog and stack overflow detection
CONFIG_ESP_TASK_WDT_EN=y
CONFIG_ESP_TASK_WDT_TIMEOUT_S=10
CONFIG_ESP_TASK_WDT_PANIC=y
CONFIG_FREERTOS_CHECK_STACKOVERFLOW_CANARY=y

# Panic handler: print panic and reboot to return to a known-safe state
CONFIG_ESP_SYSTEM_PANIC_PRINT_REBOOT=y

# Production build guard — uncomment for vehicle deployment builds
# CONFIG_PRODUCTION_BUILD=y

# Explicit bypass defaults — all disabled.
# These are the Kconfig defaults but are set explicitly here to prevent
# accidental leakage from a dirty sdkconfig.
# CONFIG_BYPASS_PLANNER_AUTONOMY_GATE is not set
# CONFIG_BYPASS_PLANNER_LIVENESS_CHECKS is not set
# CONFIG_BYPASS_PLANNER_STATE_MIRROR is not set
# CONFIG_BYPASS_CONTROL_LIVENESS_CHECKS is not set
# CONFIG_BYPASS_CONTROL_STATE_MIRROR is not set
# CONFIG_BYPASS_INPUT_PUSH_BUTTON is not set
# CONFIG_BYPASS_INPUT_RF_REMOTE is not set
# CONFIG_BYPASS_INPUT_ULTRASONIC is not set
```
